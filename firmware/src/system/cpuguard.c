/* SPDX-License-Identifier: GPL-3.0-only */
/* The predictive CPU guard (FELUCCA_CPU_GUARD, builder item CPU_GUARD; docs/CPU-GUARD.md). After Flowstate's
 * guard (firmware/src/guard.c, docs/guardrails.md 2.5) by Zakaria Chowdhury, GPL-3.0-only: its CPU part, a load
 * that is the larger of the measured one and an estimate from what sounds, held over a ceiling for 8 halves.
 *
 * Every DMA half (audio.c, the audio interrupt):
 *   cg_pre()     before the render: the prediction, the last half as measured plus what the cost model says
 *                changed since (voices started or ended; cpuguard_costs.h: target instructions a sample per
 *                engine voice, the idle mix, the drums, each X0X channel, a part's COMP insert while it runs, the drum
 *                bus's DIST and COMP;
 *                generated by tools/builder/cpu_costs.py from tests/cpu_baseline.txt and the emulator's scale,
 *                fitted so the model stays at or under the
 *                measured load). What the guard eased shows in the measurement at once. After a half over the
 *                ceiling, a half predicted to run late steps up before it renders; from NOTES on, the voices whose
 *                predicted cost brings it under the ceiling fade out at once (CG_SHED_MAX at most; none left: the reverb). Else a shed
 *                cg_post asked for.
 *   cg_post(us)  after it: the measured load (its time in the interrupt); the load is the larger of the two.
 *                Over the ceiling (85 %) for CG_HOLD halves in a row, or one half that ran late (100 %): one
 *                level up (cpuguard.h: quality, UNISON, notes, the reverb; a level with nothing to ease in what sounds
 *                now is passed). From NOTES on, a half over the ceiling sheds a voice before the next (as audio.c
 *                did on its own), never from the bass or the lead, never a drum. The drums ease at quality: their
 *                tails end sooner (a synthesised voice under -40 dBFS, an X0X 808 voice 40 dB under its peak).
 *                Release: one level down after CG_RELEASE halves (2 s) under the release level (80 %), counting
 *                the load the level saves (measured over the CG_HOLD halves after its step): a level comes off
 *                only when the music it held back would fit again, so it does not come and go every 2 s.
 * Nothing else changes: below the ceiling the guard does nothing, and the host (no timer) never steps. */
#include "cpuguard_costs.h"
#if FELUCCA_INS_JCHORUS
#define CG_COST_JUNO 140u   /* JUNO CHORUS while it runs, an instance: ~130 host instructions a sample (tests/juno_cho_test.c)
                             * x 1.04, not yet a cpu_costs.py entry */
#endif
#if CG_REV
#define REV_LIVE() ((int)rev_live)
#else
#define REV_LIVE() 0
#endif

#define CG_CEIL 218u                     /* 85 % of a half, 1/256 */
#define CG_REL (CG_CEIL - CG_CEIL / 16u) /* 80 %: the release level (Flowstate: 1/16 under the ceiling) */
#define CG_FULL 256u                     /* a whole half: late */
#define CG_HOLD 8u                       /* halves over the ceiling before a step (46 ms) */
#define CG_RELEASE 345u                  /* halves under the release level before a level comes off (2 s) */
#define CG_HALF_US (HALF_FRAMES * 1000000u / FS)   /* a half's time, us */
#define CG_FAR __attribute__((noinline))   /* (once a half, from the audio ISR: in XIP, called FAR) */
#define CG_SHED_MAX 4u                   /* voices a half predicted late fades out at most */
/* the reactive path ("Spikes"): late halves scattered among lighter ones. Each late half adds CG_SPK_HIT to a leaky count
 * that loses 1 a half; at CG_SPK_ON (3 late halves within ~30 halves, or a steady 3 a second and more) it reacts: one
 * level up, from NOTES on a voice cut (none left: the reverb) and the voices capped one under what sounded (a new note then steals the oldest).
 * One late half (a flash write, a USB burst) never reacts, nor do late halves at a light load (under CG_RFLOOR: the
 * music is not what makes them late). A level a reaction set comes off only under the load the drop-outs came at less
 * CG_RMARGIN (rcap); the cap rises a voice after CG_VSTEP halves with no late one */
#define CG_SPK_HIT 64u
#define CG_SPK_ON 160u
#define CG_RFLOOR 128u                   /* 50 % of a half: the measured mean (avg) the reactive path needs */
#define CG_RMARGIN 16u                   /* 1/16 of a half */
#ifndef CG_VSTEP
#define CG_VSTEP 345u                    /* halves (2 s) with no late one before the cap rises a voice */
#endif
/* a late half holds a level's release back only where the reactive path counts it: at a
 * mean of CG_RFLOOR or more. Under it a late half is not the music's (USB, Bluetooth, a flash write) and steps nothing,
 * so it holds nothing up either (2026-10-29, the user: "the FDN8 reverb stops working randomly": before, one late half
 * every second or two at any load kept a reaction's REVERB level, the reverb off, for good: tests/cpuguard_test.c 11) */
#define CG_LATE_HOLDS(late) ((late) && cg.avg >= CG_RFLOOR)
#define CG_VMIN 2u                       /* the cap's floor */

/* a part the guard never sheds: MONO / LEGATO / UNISON (the bass and the lead), and a monophonic engine */
static int cg_keep(const track_t *t)
{
    return t->p[P_VOICE] != V_POLY || trk_nvoice(t) == 1u;
}

static uint32_t cg_vcost(const track_t *t)   /* a voice of this part: target instructions a sample */
{
    uint32_t u = eng_uid(t->engine);
    return CG_VCOST[u < CG_NVCOST ? u : 0u];
}

#define INS_SNDI (INS_CHO || INS_REV || INS_DLY)
#if INS_SNDI
/* the CHO DLY REV inserts (fxi_send.c, 2026-10-29): a copy's cost, 0 not built */
static uint32_t cg_sndi_c(uint32_t t)
{
#if INS_CHO
    if (t == FXT_CHO)
        return CG_COST_CHOI;
#endif
#if INS_REV
    if (t == FXT_REV)
        return CG_COST_REVI;
#endif
#if INS_DLY
    if (t == FXT_DLY)
        return CG_COST_DLYI;
#endif
    (void)t;
    return 0;
}
/* a CHO DLY REV insert's wet share now on the audio's index i (limited types: their instance's) */
static __attribute__((noinline)) int32_t cg_sndi_w(uint32_t t, uint32_t i)
{
    uint32_t n = ifx_lim_at(t, i);
    if (n == FXI_NONE)
        return 0;
#if INS_CHO
    if (t == FXT_CHO)
        return ifx_choi[n % FXI_TN0].w;
#endif
#if INS_REV
    if (t == FXT_REV)
        return ifx_room[n % FXI_TN5].w;
#endif
#if INS_DLY
    if (t == FXT_DLY)
        return ifx_tdly[n % FXI_TN6].w;
#endif
    return 0;
}
/* track k's (the audio's index i: a part's, the drum bus's) CHO DLY REV inserts that run now: set (in a slot, FX on, its
 * amount: the track's P_CHOR P_REV P_DLY, the insert's MIX, with an instance) or fading */
static __attribute__((noinline)) uint32_t cg_sndi(uint32_t k, uint32_t i, int32_t on)
{
    uint32_t n = 0;
#if INS_CHO
    if ((on && INS_ON(k, FXT_CHO) && trk[k].p[P_CHOR] && ifx_has(FXT_CHO, k)) || cg_sndi_w(FXT_CHO, i))
        n += CG_COST_CHOI;
#endif
#if INS_REV
    if ((on && INS_ON(k, FXT_REV) && trk[k].p[P_REV] && ifx_has(FXT_REV, k)) || cg_sndi_w(FXT_REV, i))
        n += CG_COST_REVI;
#endif
#if INS_DLY
    if ((on && INS_ON(k, FXT_DLY) && trk[k].p[P_DLY] && ifx_has(FXT_DLY, k)) || cg_sndi_w(FXT_DLY, i))
        n += CG_COST_DLYI;
#endif
    return n;
}
#endif
/* the insert slots (fx_slots.c ins_slot, fx.c ins_part, dbus_run; D9: every slot modelled, none ever switched off):
 * part p's that run now (a sounding part): DIST while its amount is set (in a slot, FX on), the FILTER while it is
 * not at rest (set, or gliding open: fx.c tflt_block), COMP while set or letting go. The QUALITY level runs the drum
 * bus's on L / R only, 2 of its 5 channels: their cost x 2 / 5 */
static uint32_t cg_ins_part(uint32_t p)
{
    uint32_t n = 0, on = (uint32_t)fx_on(&trk[p]);
    (void)on;
#if FELUCCA_FX_DIST
    n += on && INS_ON(p, FXT_DIST) && trk[p].p[P_DIST] ? CG_COST_PDIST : 0u;
#endif
#if TFLT_ON
    n += tflt[p].mode ? CG_COST_PFILT : 0u;
#endif
#if FELUCCA_MASTER_COMP
    if ((on && INS_ON(p, FXT_COMP) && trk[p].p[P_TCOMP]) || tcomp[p].gr16 || tcomp[p].g13 != 8192)
        n += CG_COST_TCOMP;                           /* (fx.c tcomp_run: on, or letting go) */
    n += tlim[p].on ? CG_COST_TLIM : 0u;              /* (its CEIL) */
#endif
#if FELUCCA_FX_DUST
    n += on && INS_ON(p, FXT_DUST) && trk[p].p[P_TDUST] ? CG_COST_PDUST : 0u;
#endif
#if INS_FX
    {   /* the further inserts (insfx.c): set in a slot, or fading out */
        uint32_t t;
        for (t = 0; t < FXT_N; t++)
            if (IFX_FUR(t) && FXT_AMT[t] != 0xFFu && ((on && INS_ON(p, t) && trk[p].p[FXT_AMT[t]] && ifx_has(t, p)) || ifx_wn(t, p)))
                n += CG_COST_PINS[IFX_FIX(t)];
    }
#endif
#if FELUCCA_INS_JCHORUS
    if ((on && INS_ON(p, FXT_JUNO) && trk[p].p[P_TJCHO] && ifx_has(FXT_JUNO, p)) || ifx_w(FXT_JUNO, p))
        n += CG_COST_JUNO;
#endif
    if (ifx_w(FXT_EQ3, p) || (on && INS_ON(p, FXT_EQ3) && trk[p].p[P_TEQ] && !eq3_flat(EQ3_V(p))))
        n += CG_COST_EQ3M;                            /* (engaged only: flat is bypassed, eq3.c) */
#if FELUCCA_INS_XDLY
    if ((on && INS_ON(p, FXT_XDLY) && trk[p].p[P_TXDLY] && ifx_has(FXT_XDLY, p)) || ifx_w(FXT_XDLY, p))
        n += CG_COST_XDLY;                            /* (set, fading or ringing on: xdly.c) */
#endif
#if INS_SNDI
    n += cg_sndi(p, p, on);                           /* (the CHO REV DLY inserts: fxi_send.c) */
#endif
    return n;
}
static uint32_t cg_bus_w(void)                        /* the drum bus's DIST and FILTER on all 5 channels */
{
    uint32_t w = 0;
#if FELUCCA_FX_DIST
    w += dbus_live ? CG_COST_DBDIST : 0u;             /* (fx.c dbus_dist_run: a signal on it) */
#endif
#if TFLT_ON
    w += tflt[TRK_DRUM].mode ? CG_COST_DBFILT : 0u;
#endif
    return w;
}
static uint32_t cg_ins_bus(void)
{
    uint32_t w = cg_bus_w(), n = CG_LEVEL >= CG_L_QUALITY ? w * 2u / 5u : w;
#if FELUCCA_MASTER_COMP
    if ((fx_on(TDRUM) && INS_ON(TRK_DRUM, FXT_COMP) && TDRUM->p[P_TCOMP]) || !tcomp_rest(&dbus_comp))
        n += CG_COST_DBCOMP;                          /* (fx.c dbus_comp_run: on, or letting go) */
    n += tlim[TRK_DRUM].on ? CG_COST_TLIM * 2u : 0u;  /* (its CEIL, L and R) */
#endif
#if FELUCCA_FX_DUST
    n += fx_on(TDRUM) && INS_ON(TRK_DRUM, FXT_DUST) && TDRUM->p[P_TDUST] ? CG_COST_DBDUST : 0u;
#endif
#if INS_FX
    {   /* the further inserts (insfx.c ifx_bus: L and R at every level) */
        uint32_t t;
        for (t = 0; t < FXT_N; t++)
            if (IFX_FUR(t) && FXT_AMT[t] != 0xFFu && ((fx_on(TDRUM) && INS_ON(TRK_DRUM, t) && TDRUM->p[FXT_AMT[t]] && ifx_has(t, TRK_DRUM)) || ifx_wn(t, IFX_BUS)))
                n += CG_COST_DBINS[IFX_FIX(t)];
    }
#endif
#if FELUCCA_INS_JCHORUS
    if ((fx_on(TDRUM) && INS_ON(TRK_DRUM, FXT_JUNO) && TDRUM->p[P_TJCHO] && ifx_has(FXT_JUNO, TRK_DRUM)) || ifx_w(FXT_JUNO, IFX_BUS))
        n += CG_COST_JUNO;                            /* (its one stereo instance) */
#endif
    if (ifx_w(FXT_EQ3, IFX_BUS) || (fx_on(TDRUM) && INS_ON(TRK_DRUM, FXT_EQ3) && TDRUM->p[P_TEQ] && !eq3_flat(EQ3_V(TRK_DRUM))))
        n += CG_COST_EQ3S;
#if FELUCCA_INS_XDLY
    if ((fx_on(TDRUM) && INS_ON(TRK_DRUM, FXT_XDLY) && TDRUM->p[P_TXDLY] && ifx_has(FXT_XDLY, TRK_DRUM)) || ifx_w(FXT_XDLY, TRK_DRUM))
        n += CG_COST_XDLY;                            /* (its one instance on the bus's mid) */
#endif
#if INS_SNDI
    n += cg_sndi(TRK_DRUM, TRK_DRUM, fx_on(TDRUM));   /* (one stereo instance each, on the bus's mid) */
#endif
    return n;
}

#if DINS
/* a drum voice's slots that ran (fx.c dins_post: a type bit each), each its measured per-voice cost (cpu/fx/dvoice_*) */
static uint32_t cg_dvoice(uint32_t m)
{
    uint32_t n = 0;
    n += m & FXT_BIT(FXT_DIST) ? CG_COST_DVDIST : 0u;
    n += m & FXT_BIT(FXT_DYN) ? CG_COST_DVCOMP : 0u;
    n += m & FXT_BIT(FXT_FILT) ? CG_COST_DVINS[0] : 0u;
    n += m & FXT_BIT(FXT_DUST) ? CG_COST_DVINS[1] : 0u;
    n += m & FXT_BIT(FXT_FOLD) ? CG_COST_DVINS[2] : 0u;
    n += m & FXT_BIT(FXT_FUZZ) ? CG_COST_DVINS[3] : 0u;
    n += m & FXT_BIT(FXT_PHSR) ? CG_COST_DVINS[4] : 0u;
    n += m & FXT_BIT(FXT_FRMT) ? CG_COST_DVINS[5] : 0u;
    n += m & FXT_BIT(FXT_SFLD) ? CG_COST_DVINS[6] : 0u;   /* (the shapers, 2026-10-18: fx_slots.c LIN_T, SUB not there) */
    n += m & FXT_BIT(FXT_WRAP) ? CG_COST_DVINS[7] : 0u;
    n += m & FXT_BIT(FXT_RECT) ? CG_COST_DVINS[8] : 0u;
    n += m & FXT_BIT(FXT_HARM) ? CG_COST_DVINS[9] : 0u;
    n += m & FXT_BIT(FXT_RING) ? CG_COST_DVINS[10] : 0u;
    n += m & FXT_BIT(FXT_SLEW) ? CG_COST_DVINS[11] : 0u;
    n += m & FXT_BIT(FXT_EQ3) ? CG_COST_EQ3M : 0u;   /* (dins_one: it ran, engaged or fading) */
    return n;
}
#endif
/* the master's insert slots that run (fx.c mst_run, fx-rework): their costs on the drum bus, the same kernels on a
 * stereo pair (DIST and FILTER: the bus's 5 channels' 2 / 5; DYN's compressor: CG_COST_DBCOMP; its limiter was in the
 * idle mix before, CG_COST_BASE). In no slot or at 0: nothing */
static uint32_t cg_ins_mst(void)
{
    uint32_t n = 0, t;
    for (t = 0; t < FXT_N; t++) {
        if (!MST_ON(t))
            continue;
        if (t == FXT_DIST && mst_amt[FXT_DIST])
            n += CG_COST_DBDIST * 2u / 5u;
#if TFLT_ON
        if (t == FXT_FILT && tflt[NTRK].mode)
            n += CG_COST_DBFILT * 2u / 5u;
#endif
#if FELUCCA_MASTER_COMP
        if (t == FXT_DYN && song.g[G_CTHR])
            n += CG_COST_DBCOMP;
#endif
        if (t == FXT_DUST && FELUCCA_FX_DUST && song.g[G_DUST])
            n += CG_COST_DBDUST;
        if (IFX_FUR(t) && mst_amt[t])
            n += CG_COST_DBINS[IFX_FIX(t)];
#if FELUCCA_INS_JCHORUS
        if (t == FXT_JUNO && (mst_amt[FXT_JUNO] || ifx_w(FXT_JUNO, IFX_MST)))
            n += CG_COST_JUNO;
#endif
        if (t == FXT_EQ3 && (ifx_w(FXT_EQ3, IFX_MST) || (mst_amt[FXT_EQ3] && !eq3_flat(EQ3_V(NTRK)))))
            n += CG_COST_EQ3S;
#if FELUCCA_INS_XDLY
        if (t == FXT_XDLY && (mst_amt[FXT_XDLY] || ifx_w(FXT_XDLY, IFX_MST)))
            n += CG_COST_XDLY;
#endif
#if INS_SNDI
        if (FXT_SENDS >> t & 1u && (mst_amt[t] || cg_sndi_w(t, IFX_MST)))
            n += cg_sndi_c(t);
#endif
    }
    return n;
}
/* the returns holding another type (fx.c rt_run, fx-pool 2026-10-15): the master's costs of the same kernels on a stereo pair,
 * while set or letting go (its tail) */
static uint32_t cg_ins_rt(void)
{
    uint32_t n = 0, j, t;
    for (j = 0; j < 3u; j++) {
        int32_t a;
        t = fxs_rty[j];
        if (t == FXT_NONE)
            continue;
        a = rt_amt(j);
        if (t == FXT_DIST && a)
            n += CG_COST_DBDIST * 2u / 5u;
#if TFLT_ON
        if (t == FXT_FILT && rt_sto[j].f.mode)
            n += CG_COST_DBFILT * 2u / 5u;
#endif
#if FELUCCA_MASTER_COMP
        if (t == FXT_DYN && a)
            n += CG_COST_DBCOMP;
#endif
        if (t == FXT_DUST && FELUCCA_FX_DUST && a)
            n += CG_COST_DBDUST;
#if INS_FX
        if (IFX_FUR(t) && (a || ifx_wn(t, IFX_RT(j))))
            n += CG_COST_DBINS[IFX_FIX(t)];
#endif
#if FELUCCA_INS_JCHORUS
        if (t == FXT_JUNO && (a || ifx_w(FXT_JUNO, IFX_RT(j))))
            n += CG_COST_JUNO;
#endif
        if (t == FXT_EQ3 && (ifx_w(FXT_EQ3, IFX_RT(j)) || (a && !eq3_flat(EQ3_V(NTRK + 2u + j)))))
            n += CG_COST_EQ3S;
    }
    return n;
}
#if FELUCCA_USB_AUDIO
/* the USB input's insert slots (fx.c ut_mix, any insert type since 2026-10-15): the master's costs of the same kernels on a
 * stereo pair, while set (FX on) or letting go (its wet share; DIST FILT DYN DUST: their own states) */
static uint32_t cg_ins_ut(void)
{
    uint32_t n = 0, s, t;
    for (s = 0; s < INS_N; s++) {
        int32_t a;
        t = ut.slot[s];
        if (t >= FXT_N || !(UT_OK >> t & 1u))
            continue;
        a = ut.v[UTV_FXON] ? ut.amt[s] : 0;
        if (t == FXT_DIST && a)
            n += CG_COST_DBDIST * 2u / 5u;
#if TFLT_ON
        if (t == FXT_FILT && ut_sto.f.mode)
            n += CG_COST_DBFILT * 2u / 5u;
#endif
#if FELUCCA_MASTER_COMP
        if (t == FXT_DYN && a)
            n += CG_COST_DBCOMP;
#endif
        if (t == FXT_DUST && FELUCCA_FX_DUST && a)
            n += CG_COST_DBDUST;
#if INS_FX
        if (IFX_FUR(t) && (a || ifx_wn(t, IFX_UT)))   /* (ECHO FLNG: only with an instance, ifx_w 0
                                                        * without; GATER: one gain, the bus's cost) */
            n += CG_COST_DBINS[IFX_FIX(t)];
#endif
#if FELUCCA_INS_JCHORUS
        if (t == FXT_JUNO && (a || ifx_w(FXT_JUNO, IFX_UT)))
            n += CG_COST_JUNO;
#endif
        if (t == FXT_EQ3 && (ifx_w(FXT_EQ3, IFX_UT) || (a && !eq3_flat(EQ3_V(NTRK + 1u)))))
            n += CG_COST_EQ3S;
#if INS_SNDI
        if (FXT_SENDS >> t & 1u && (a || cg_sndi_w(t, IFX_UT)))
            n += cg_sndi_c(t);                        /* (the CHO DLY REV inserts: fxi_send.c) */
#endif
    }
    return n;
}
#else
#define cg_ins_ut() 0u
#endif
/* the predicted cost of what sounds now: target instructions a sample */
static uint32_t cg_est(void)
{
    uint32_t p, i, n = CG_COST_BASE;
    for (p = 0; p < NPART; p++) {
        uint32_t c = cg_vcost(&trk[p]), on = 0;
        for (i = 0; i < NVOICE; i++)
            on |= trk[p].v[i].active, n += trk[p].v[i].active ? c : 0u;
        if (on)
            n += cg_ins_part(p);                      /* its insert slots that run (fx.c ins_part) */
    }
    for (i = 0; FELUCCA_DRUMS && i < NDRUM; i++)
        if (drums.v[i].active) {
            n += CG_COST_DRUMS;
            break;
        }
    n += FELUCCA_DRUMS ? cg_ins_bus() : 0u;           /* the drum bus's insert slots that run (fx.c dbus_run) */
    n += cg_ins_mst();                                /* the master's (fx.c mst_run) */
    n += cg_ins_rt();                                 /* the returns' other types (fx.c rt_run) */
    n += cg_ins_ut();                                 /* the USB input's (fx.c ut_mix) */
#if DINS
    for (i = 0; i < DINS_N; i++)                      /* each drum voice's inserts that ran (fx.c dins_post), each X0X lane's */
        n += cg_dvoice(dins_ran[i]);
#endif
#if DRUM_X0X
    {   /* the X0X channels sounding or with a hit due (drum_x0x.c: not drums.v voices), each its own cost, and
         * their mix once */
        uint32_t m = x0x_sounding();
        n += m ? CG_X0X_SHARED : 0u;
        for (i = 0; m; i++, m >>= 1)
            n += m & 1u ? CG_X0X[i] : 0u;
    }
#endif
    return n;
}

/* one voice, as audio.c shed_voice but never from a part cg_keep keeps: the quietest releasing voice fades out
 * (voice_kill), else the oldest held one goes into its release (fast: fades out too), while another voice is held
 * anywhere (the only held voice is never touched). Returns that voice's predicted cost, 0 = none shed */
static voice_t *cg_pick(int *held)                     /* the voice cg_shed would take (0: none), *held: a held one */
{
    uint32_t p, i, ngate = 0;
    voice_t *best = 0, *old = 0;
    for (p = 0; p < NPART; p++)
        for (i = 0; i < NVOICE; i++) {
            voice_t *v = &trk[p].v[i];
            int keep = cg_keep(&trk[p]);
            if (!v->active)
                continue;
            if (v->gate) {
                ngate++;
                if (!keep && (!old || v->age < old->age))
                    old = v;
            } else if (!keep && v->stage != 4u && (!best || v->env < best->env)) {
                best = v;
            }
        }
    *held = !best;
    return best ? best : old && ngate > 1u ? old : 0;
}
static int cg_sheddable(void)                           /* a voice is left to shed (the reverb goes only when none is) */
{
    int held;
    return cg_pick(&held) != 0;
}
static uint32_t cg_shed(int fast)
{
    uint32_t p;
    int held;
    voice_t *best = cg_pick(&held);
    if (!best)
        return 0;
    if (!held || fast) {
        voice_kill(best);
    } else {
        best->gate = 0;
        best->stage = 3;
    }
    cg.sheds++;
    for (p = 0; p < NPART; p++)                       /* (its part's voice cost) */
        if (best >= trk[p].v && best < trk[p].v + NVOICE)
            break;
    return cg_vcost(&trk[p < NPART ? p : 0u]);
}

#if FELUCCA_ENG_ACID
#define CG_ACID(e) ((e) == &ENG_ACID)
#else
#define CG_ACID(e) 0
#endif
#if FELUCCA_ENG_ANALOG && FELUCCA_ANALOG2
#define CG_SWARMED(e, t) ((e) == &ENG_ANALOG && (t)->p[P_A2SWRM] > 2)
#else
#define CG_SWARMED(e, t) 0
#endif
/* a drum tail the quality level shortens sounds: a synthesised drum voice, an X0X 808 channel (cpuguard.h CG_DTAIL) */
static int cg_tails(void)
{
    uint32_t i;
#if FELUCCA_DRUM_X808
    if (x0x_sounding() >> 11)                         /* (drum_x0x.c: the 808's channels 11..23) */
        return 1;
#endif
    for (i = 0; FELUCCA_DRUMS && i < NDRUM; i++)
        if (drums.v[i].active && drums.synth[i])
            return 1;
    return 0;
}

/* the level would ease something that sounds now: ACID, ANALOG 2 with a swarm of more than 2 copies, or a drum
 * tail (quality); a UNISON part of more than 2 voices (UNISON); a voice left to shed (NOTES: cg_pick, never a
 * cg_keep part nor the only held voice); the reverb's tank running or sent something (REVERB) */
static int cg_useful(uint32_t level)
{
    uint32_t p;
    if (level == CG_L_NOTES)
        return cg_sheddable();
    if (level == CG_L_QUALITY && (cg_tails() || (FELUCCA_DRUMS && cg_bus_w())))
        return 1;                                     /* (a drum tail, or the drum bus's DIST / FILTER: L / R only) */
    if (level == CG_L_REVERB)                         /* the reverb bus runs (or would: fx.c rev_live) */
        return REV_LIVE();
    for (p = 0; p < NPART; p++) {
        const track_t *t = &trk[p];
        const engine_t *e = ENGINES[t->engine];
        uint32_t i, on = 0;
        (void)e;                                        /* (CG_ACID, CG_SWARMED: 0 without ACID and ANALOG 2) */
        for (i = 0; i < NVOICE; i++)
            on |= t->v[i].active;
        if (!on)
            continue;
        if (level == CG_L_QUALITY && (CG_ACID(e) || CG_SWARMED(e, t)))
            return 1;
        if (level == CG_L_UNISON && t->p[P_VOICE] == V_UNISON && trk_nvoice(t) > 2u)
            return 1;
    }
    return 0;
}

/* a level above this one has something to ease now (none: the step waits, the level stays) */
static int cg_up_ok(void)
{
    uint32_t l;
    for (l = cg.level + 1u; l <= CG_TOP; l++)
        if (cg_useful(l))
            return 1;
    return 0;
}
/* what a level does once, as it is entered (the rest the render reads from CG_LEVEL) */
static void cg_enter(uint32_t level)
{
    uint32_t p, i;
    if (level == CG_L_UNISON)            /* UNISON parts: their voices past the second fade out now */
        for (p = 0; p < NPART; p++)
            for (i = 2; i < NVOICE && trk[p].p[P_VOICE] == V_UNISON; i++)
                if (trk[p].v[i].active && trk[p].v[i].stage != 4u)
                    voice_kill(&trk[p].v[i]);
}
/* one level up, past the levels with nothing to ease now; what it saves is measured over the next halves */
static void cg_step(void)
{
    if (!cg_up_ok())
        return;
    do
        cg.level++;
    while (cg.level < CG_TOP && !cg_useful(cg.level));
    cg.over = 0;
    cg.under = 0;
    cg.steps++;
    cg.gpend = cg.level != CG_L_NOTES ? cg.level : 0u;   /* (NOTES sheds: nothing comes back when it comes off; the
                                          * reverb above it does) */
    cg.smeas = cg.meas;
    cg.gpre = cg.avg;                   /* (the load before: a spike's own half would make the level stay for ever) */
    cg.gn = 0;
    cg.gsum = 0;
    cg_enter(cg.level);
}

/* audio ISR, a half's start, before its render */
static CG_FAR void cg_pre(void)
{
    uint32_t e, k;
    int32_t pred;
    if (!cg.ips) {
        cg.ips = (uint16_t)(cpu_khz * 1000u / FS);   /* 0 until the clock is known (the host: never) */
        if (!cg.ips)
            return;
        cg.model = (uint16_t)(cg_est() * 256u / cg.ips);
    }
    e = cg_est() * 256u / cg.ips;        /* the model now; the prediction: the last half as measured, plus the
                                          * model's change since (voices started, ended) */
    pred = (int32_t)cg.meas + (int32_t)e - (int32_t)cg.model;
    pred = pred < 0 ? 0 : pred < 0xFFFF ? pred : 0xFFFF;
    cg.model = (uint16_t)(e < 0xFFFFu ? e : 0xFFFFu);
    if (pred >= (int32_t)CG_FULL && cg.meas > CG_CEIL && cg.meas < CG_FULL && !(cg.gpend && !cg.gn)) {   /* predicted late after a half
                                          * over the ceiling (the model alone counts the voices of a half that started
                                          * them twice): before it renders, a step; from NOTES on voices fade out. Not in
                                          * the half right after a step (gpend, none measured since: what the step
                                          * saved is not in cg.meas yet; a late half stepped twice, e.g. UNISON
                                          * at 2 voices and then the next level) */
        cg.early++;
        if (!CG_SHEDS(cg.level)) {
            cg_step();
        } else {                         /* (NOTES and up: voices first; none left to shed, the next level: the reverb) */
            for (k = 0; k < CG_SHED_MAX && pred >= (int32_t)CG_CEIL; k++) {
                uint32_t c = cg_shed(1);
                if (!c)
                    break;
                pred -= (int32_t)(c * 256u / cg.ips);
            }
            if (!k)
                cg_step();
            cg.shed = 0;
        }
    }
    cg.est = (uint16_t)(pred < 0 ? 0 : pred);
    if (cg.shed) {
        cg.shed = 0;
        cg_shed(0);
    }
#if FELUCCA_DRUM_X808
    x0x_tails(cg.level >= CG_L_QUALITY);              /* (the 808's tails: x0x/x0x_drums.c; the synthesised kits'
                                                       * read CG_DTAIL) */
#endif
}

#if FELUCCA_BENCH                         /* (measurements, bench.c: level, steps, early, sheds, halves, the sums of
                                          * the predicted and the measured loads, the highest level) */
static volatile uint32_t cg_bench[8];
static volatile uint32_t cg_trace[1024] __attribute__((section(".pool")));   /* per half: level, sheds, est, meas */
#define CG_TRACE(m) (cg_bench[4] < 1024u ? cg_trace[cg_bench[4]] = cg.level << 28 | (cg.sheds & 0xFFFu) << 16 | \
                     (cg.est > 255u ? 255u : cg.est) << 8 | ((m) > 255u ? 255u : (m)) : 0u)
#define CG_BENCH(m) (CG_TRACE(m), cg_bench[0] = cg.level, cg_bench[1] = cg.steps, cg_bench[2] = cg.early, cg_bench[3] = cg.sheds, \
                     cg_bench[4]++, cg_bench[5] += cg.est, cg_bench[6] += (m), \
                     cg_bench[7] = cg.level > cg_bench[7] ? cg.level : cg_bench[7])
#else
#define CG_BENCH(m) ((void)0)
#endif

/* the reactive path, once a half (late: this half ran late): the leaky count, a reaction at CG_SPK_ON; the cap's rise */
static void cg_spike(uint32_t late)
{
    uint32_t r;
    if (late)
        cg.spk = (uint16_t)(cg.spk + CG_SPK_HIT < 0xFFFFu ? cg.spk + CG_SPK_HIT : 0xFFFFu);
    else if (cg.spk)
        cg.spk--;
    if (cg.vcap) {                       /* (the cap: a voice back after CG_VSTEP halves with none late; NVOICE: off) */
        if (late)
            cg.vcn = 0;
        else if (++cg.vcn >= CG_VSTEP) {
            cg.vcn = 0;
            cg.vcap = (uint8_t)(cg.vcap + 1u < NVOICE ? cg.vcap + 1u : 0u);
        }
    }
    if (cg.spk < CG_SPK_ON || !cg_react || cg.avg < CG_RFLOOR)
        return;
    cg.spk = 0;
    cg.reacts++;
    r = cg.avg > CG_RMARGIN + 1u ? cg.avg - CG_RMARGIN : 1u;   /* (the load the drop-outs came at, less the margin) */
    if (!CG_SHEDS(cg.level)) {
        cg_step();
    } else {
        uint32_t busy = voices_busy();
        if (cg_shed(1)) {                /* a voice cut now, the rest capped one under what sounded */
            busy = busy > CG_VMIN + 1u ? busy - 1u : CG_VMIN;
            cg.vcap = (uint8_t)(!cg.vcap || busy < cg.vcap ? busy : cg.vcap - (cg.vcap > CG_VMIN));
            cg.vcn = 0;
        } else {
            cg_step();                   /* (no voice left to cut: the next level, the reverb, if it runs) */
        }
    }
    cg.rcap[cg.level] = (uint8_t)(r < 255u ? r : 255u);
}

/* audio ISR, a half's end: it took us microseconds (cg.late: the DMA moved on while it rendered, audio.c) */
static CG_FAR void cg_post(uint32_t us)
{
    uint32_t m = us * 256u / CG_HALF_US, load = m > cg.est ? m : cg.est, prev = cg.meas, c, late = m >= CG_FULL || cg.late;
    m = m < 0xFFFFu ? m : 0xFFFFu;
    load = load < 0xFFFFu ? load : 0xFFFFu;
    c = m < CG_FULL ? m : CG_FULL;
    cg.meas = (uint16_t)m;
    cg.load = (uint16_t)load;
    CG_BENCH(m);
    if (cg.gpend) {                      /* what the last step saved: the measured load before it less the next
                                          * halves' */
        cg.gsum += c;
        if (++cg.gn >= CG_HOLD) {
            uint32_t after = cg.gsum / CG_HOLD;
            cg.gain[cg.gpend] = (uint8_t)(cg.gpre > after ? (cg.gpre - after < 255u ? cg.gpre - after : 255u) : 0u);
            cg.gpend = 0;
        }
    }
    if (load > CG_CEIL) {
        cg.under = 0;
        if (CG_SHEDS(cg.level)) {
            cg.shed = m > CG_CEIL;       /* (as audio.c: a half over 85 % sheds one voice before the next) */
            if (cg_sheddable() || cg.level >= CG_TOP)
                cg.over = 0;             /* (voices left: they go first, the reverb stays) */
            else if ((m >= CG_FULL && prev > CG_CEIL) || ++cg.over >= CG_HOLD)
                cg_step();               /* (none left and still over: the reverb, if it runs; cg_up_ok) */
        } else if ((m >= CG_FULL && prev > CG_CEIL) || ++cg.over >= CG_HOLD) {   /* (a late half after one over
                                          * the ceiling; a lone late half, a flash write or another interrupt's
                                          * burst, is not a load: as audio.c without the guard) */
            cg_step();
        }
    } else {
        uint32_t back = load + cg.gain[cg.level];   /* (the load with the level's saving back) */
        cg.over = 0;
        if (cg.level && !CG_LATE_HOLDS(late) && (!cg.vcap || cg.level > CG_L_NOTES) && back < CG_REL &&
            (!cg.rcap[cg.level] || back < cg.rcap[cg.level])) {
            if (++cg.under >= CG_RELEASE) {   /* one level off, and the ones under it with nothing to ease now. A level
                                          * a reaction set: only under the load the drop-outs came at (rcap). The
                                          * voice cap holds NOTES and the levels under it, not the reverb above it:
                                          * the reverb comes back first, the voices after (they went first). (The
                                          * reverb is the top since 2026-10-30: never met on the way down, so the old
                                          * "pass it while the reverb runs" has nothing left to pass) */
                do
                    cg.rcap[cg.level--] = 0;
                while (cg.level && !cg_useful(cg.level));
                if (!CG_SHEDS(cg.level))
                    cg.vcap = 0;         /* (the cap is NOTES': off with it, NOTES passed with nothing to shed too) */
                cg.under = 0;
            }
        } else {
            cg.under = 0;
        }
    }
    cg.avg = (uint16_t)((cg.avg * 7u + c + 4u) >> 3);   /* (after the step: its load before is the one before) */
    cg.late = 0;
    cg_spike(late);
}
