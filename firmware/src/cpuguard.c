/* SPDX-License-Identifier: GPL-3.0-only */
/* The predictive CPU guard (FELUCCA_CPU_GUARD, builder item CPU_GUARD; docs/CPU-GUARD.md). After Flowstate's
 * guard (firmware/src/guard.c, docs/guardrails.md 2.5) by Zakaria Chowdhury, GPL-3.0-only: its CPU part, a load
 * that is the larger of the measured one and an estimate from what sounds, held over a ceiling for 8 halves.
 *
 * Every DMA half (audio.c, the audio interrupt):
 *   cg_pre()     before the render: the prediction, the last half as measured plus what the cost model says
 *                changed since (voices started or ended; cpuguard_costs.h: target instructions a sample per
 *                engine voice, the idle mix, the drums, generated by tools/builder/cpu_costs.py from
 *                tests/cpu_baseline.txt and the emulator's scale, fitted so the model stays at or under the
 *                measured load). What the guard eased shows in the measurement at once. After a half over the
 *                ceiling, a half predicted to run late steps up before it renders; at the top, the voices whose
 *                predicted cost brings it under the ceiling fade out at once (CG_SHED_MAX at most). Else a shed
 *                cg_post asked for.
 *   cg_post(us)  after it: the measured load (its time in the interrupt); the load is the larger of the two.
 *                Over the ceiling (85 %) for CG_HOLD halves in a row, or one half that ran late (100 %): one
 *                level up (cpuguard.h: quality, UNISON, notes; a level with nothing to ease in what sounds
 *                now is passed). At the top, a half over the ceiling sheds a voice before the next (as audio.c
 *                did on its own), never from the bass or the lead.
 *                Release: one level down after CG_RELEASE halves (2 s) under the release level (80 %), counting
 *                the load the level saves (measured over the CG_HOLD halves after its step): a level comes off
 *                only when the music it held back would fit again, so it does not come and go every 2 s.
 * Nothing else changes: below the ceiling the guard does nothing, and the host (no timer) never steps. */
#include "cpuguard_costs.h"

#define CG_CEIL 218u                     /* 85 % of a half, 1/256 */
#define CG_REL (CG_CEIL - CG_CEIL / 16u) /* 80 %: the release level (Flowstate: 1/16 under the ceiling) */
#define CG_FULL 256u                     /* a whole half: late */
#define CG_HOLD 8u                       /* halves over the ceiling before a step (46 ms) */
#define CG_RELEASE 345u                  /* halves under the release level before a level comes off (2 s) */
#define CG_HALF_US (HALF_FRAMES * 1000000u / FS)   /* a half's time, us */
#define CG_FAR __attribute__((noinline))   /* (once a half, from the audio ISR: in XIP, called FAR) */
#define CG_SHED_MAX 4u                   /* voices a half predicted late fades out at most */

/* a part the guard never sheds: MONO / LEGATO / UNISON (the bass and the lead), and a monophonic engine */
static int cg_keep(const track_t *t)
{
    return t->p[P_VOICE] != V_POLY || ENGINES[t->engine]->poly == 1u;
}

static uint32_t cg_vcost(const track_t *t)   /* a voice of this part: target instructions a sample */
{
    uint32_t u = eng_uid(t->engine);
    return CG_VCOST[u < CG_NVCOST ? u : 0u];
}

/* the predicted cost of what sounds now: target instructions a sample */
static uint32_t cg_est(void)
{
    uint32_t p, i, n = CG_COST_BASE;
    for (p = 0; p < NPART; p++) {
        uint32_t c = cg_vcost(&trk[p]);
        for (i = 0; i < NVOICE; i++)
            n += trk[p].v[i].active ? c : 0u;
    }
    for (i = 0; i < NDRUM; i++)
        if (drums.v[i].active) {
            n += CG_COST_DRUMS;
            break;
        }
    return n;
}

/* one voice, as audio.c shed_voice but never from a part cg_keep keeps: the quietest releasing voice fades out
 * (voice_kill), else the oldest held one goes into its release (fast: fades out too), while another voice is held
 * anywhere (the only held voice is never touched). Returns that voice's predicted cost, 0 = none shed */
static uint32_t cg_shed(int fast)
{
    uint32_t p, i, ngate = 0;
    voice_t *best = 0, *old = 0;
    for (p = 0; p < NPART; p++)
        for (i = 0; i < NVOICE; i++) {
            voice_t *v = &trk[p].v[i];
            int keep = cg_keep(&trk[p]);
            if (!v->active)
                continue;
            if (v->gate) {
                ngate++;
                if (!keep && (!old || v->age < old->age))
                    old = v;
            } else if (!keep && v->stage != 4u && (!best || v->env < best->env)) {
                best = v;
            }
        }
    if (best) {
        voice_kill(best);
    } else if (old && ngate > 1u) {
        best = old;
        if (fast) {
            voice_kill(old);
        } else {
            old->gate = 0;
            old->stage = 3;
        }
    } else {
        return 0;
    }
    cg.sheds++;
    for (p = 0; p < NPART; p++)                       /* (its part's voice cost) */
        if (best >= trk[p].v && best < trk[p].v + NVOICE)
            break;
    return cg_vcost(&trk[p < NPART ? p : 0u]);
}

#if FELUCCA_ENG_ACID
#define CG_ACID(e) ((e) == &ENG_ACID)
#else
#define CG_ACID(e) 0
#endif
#if FELUCCA_ENG_ANALOG && FELUCCA_ANALOG2
#define CG_SWARMED(e, t) ((e) == &ENG_ANALOG && (t)->p[P_A2SWRM] > 2)
#else
#define CG_SWARMED(e, t) 0
#endif
/* the level would ease something that sounds now: ACID, or ANALOG 2 with a swarm of more than 2 copies (quality);
 * a UNISON part of more than 2 voices (UNISON); the top always (it sheds) */
static int cg_useful(uint32_t level)
{
    uint32_t p;
    if (level >= CG_TOP)
        return 1;
    for (p = 0; p < NPART; p++) {
        const track_t *t = &trk[p];
        const engine_t *e = ENGINES[t->engine];
        uint32_t i, on = 0;
        for (i = 0; i < NVOICE; i++)
            on |= t->v[i].active;
        if (!on)
            continue;
        if (level == CG_L_QUALITY && (CG_ACID(e) || CG_SWARMED(e, t)))
            return 1;
        if (level == CG_L_UNISON && t->p[P_VOICE] == V_UNISON && (e->poly == 0u || e->poly > 2u))
            return 1;
    }
    return 0;
}

/* one level up, past the levels with nothing to ease now; what it saves is measured over the next halves */
static void cg_step(void)
{
    uint32_t p, i;
    if (cg.level >= CG_TOP)
        return;
    do
        cg.level++;
    while (!cg_useful(cg.level));
    cg.over = 0;
    cg.under = 0;
    cg.steps++;
    cg.gpend = cg.level < CG_TOP ? cg.level : 0u;   /* (the top sheds: nothing comes back when it comes off) */
    cg.gpre = cg.meas;
    cg.gn = 0;
    cg.gsum = 0;
    if (cg.level == CG_L_UNISON)         /* UNISON parts: their voices past the second fade out now */
        for (p = 0; p < NPART; p++)
            for (i = 2; i < NVOICE && trk[p].p[P_VOICE] == V_UNISON; i++)
                if (trk[p].v[i].active && trk[p].v[i].stage != 4u)
                    voice_kill(&trk[p].v[i]);
}

/* audio ISR, a half's start, before its render */
static CG_FAR void cg_pre(void)
{
    uint32_t e, k;
    int32_t pred;
    if (!cg.ips) {
        cg.ips = (uint16_t)(cpu_khz * 1000u / FS);   /* 0 until the clock is known (the host: never) */
        if (!cg.ips)
            return;
        cg.model = (uint16_t)(cg_est() * 256u / cg.ips);
    }
    e = cg_est() * 256u / cg.ips;        /* the model now; the prediction: the last half as measured, plus the
                                          * model's change since (voices started, ended) */
    pred = (int32_t)cg.meas + (int32_t)e - (int32_t)cg.model;
    pred = pred < 0 ? 0 : pred < 0xFFFF ? pred : 0xFFFF;
    cg.model = (uint16_t)(e < 0xFFFFu ? e : 0xFFFFu);
    if (pred >= (int32_t)CG_FULL && cg.meas > CG_CEIL) {   /* predicted late after a half over the ceiling (the
                                          * model alone counts the voices of a half that started them twice): before
                                          * it renders, a step; at the top voices fade out */
        cg.early++;
        if (cg.level < CG_TOP) {
            cg_step();
        } else {
            for (k = 0; k < CG_SHED_MAX && pred >= (int32_t)CG_CEIL; k++) {
                uint32_t c = cg_shed(1);
                if (!c)
                    break;
                pred -= (int32_t)(c * 256u / cg.ips);
            }
            cg.shed = 0;
        }
    }
    cg.est = (uint16_t)(pred < 0 ? 0 : pred);
    if (cg.shed) {
        cg.shed = 0;
        cg_shed(0);
    }
}

#if FELUCCA_BENCH                         /* (measurements, bench.c: level, steps, early, sheds, halves, the sums of
                                          * the predicted and the measured loads, the highest level) */
static volatile uint32_t cg_bench[8];
static volatile uint32_t cg_trace[1024] __attribute__((section(".pool")));   /* per half: level, sheds, est, meas */
#define CG_TRACE(m) (cg_bench[4] < 1024u ? cg_trace[cg_bench[4]] = cg.level << 28 | (cg.sheds & 0xFFFu) << 16 | \
                     (cg.est > 255u ? 255u : cg.est) << 8 | ((m) > 255u ? 255u : (m)) : 0u)
#define CG_BENCH(m) (CG_TRACE(m), cg_bench[0] = cg.level, cg_bench[1] = cg.steps, cg_bench[2] = cg.early, cg_bench[3] = cg.sheds, \
                     cg_bench[4]++, cg_bench[5] += cg.est, cg_bench[6] += (m), \
                     cg_bench[7] = cg.level > cg_bench[7] ? cg.level : cg_bench[7])
#else
#define CG_BENCH(m) ((void)0)
#endif

/* audio ISR, a half's end: it took us microseconds */
static CG_FAR void cg_post(uint32_t us)
{
    uint32_t m = us * 256u / CG_HALF_US, load = m > cg.est ? m : cg.est;
    m = m < 0xFFFFu ? m : 0xFFFFu;
    load = load < 0xFFFFu ? load : 0xFFFFu;
    cg.meas = (uint16_t)m;
    cg.load = (uint16_t)load;
    CG_BENCH(m);
    if (cg.gpend) {                      /* what the last step saved: the measured load before it less the next
                                          * halves' */
        cg.gsum += m;
        if (++cg.gn >= CG_HOLD) {
            uint32_t after = cg.gsum / CG_HOLD;
            cg.gain[cg.gpend] = (uint8_t)(cg.gpre > after ? (cg.gpre - after < 255u ? cg.gpre - after : 255u) : 0u);
            cg.gpend = 0;
        }
    }
    if (load > CG_CEIL) {
        cg.under = 0;
        if (cg.level >= CG_TOP) {
            cg.over = 0;
            cg.shed = m > CG_CEIL;       /* (as audio.c: a half over 85 % sheds one voice before the next) */
        } else if (m >= CG_FULL || ++cg.over >= CG_HOLD) {
            cg_step();
        }
        return;
    }
    cg.over = 0;
    if (cg.level && load + cg.gain[cg.level] < CG_REL) {
        if (++cg.under >= CG_RELEASE) {  /* one level off, and the ones under it with nothing to ease now */
            do
                cg.level--;
            while (cg.level && !cg_useful(cg.level));
            cg.under = 0;
        }
    } else {
        cg.under = 0;
    }
}
